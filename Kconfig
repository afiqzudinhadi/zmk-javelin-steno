## Kconfig
```kconfig
menu "Javelin Steno Engine"

config ZMK_JAVELIN_STENO
    bool "Enable Javelin steno engine"
    default n
    select CPLUSPLUS
    select LIB_CPLUSPLUS

if ZMK_JAVELIN_STENO

config ZMK_JAVELIN_STENO_DICT_PLOVER
    bool "Include Plover dictionary (standard English)"
    default y

config ZMK_JAVELIN_STENO_DICT_LAPWING
    bool "Include Lapwing dictionary (modern, recommended for new learners)"
    default n

endif # ZMK_JAVELIN_STENO

endmenu
```

## dts/bindings/behaviors/zmk,behavior-javelin-steno.yaml
```yaml
description: |
  Javelin steno behavior — maps key positions to steno keys and feeds
  them into the on-board Javelin steno engine for chord-based text input.

compatible: "zmk,behavior-javelin-steno"

include: one_param.yaml

properties:
  "#binding-cells":
    const: 1
```
